## arch/arm/mach-apple/Kconfig
```kconfig
if ARCH_APPLE

config SYS_TEXT_BASE
	default 0x00000000

config SYS_CONFIG_NAME
	default "apple"

config SYS_SOC
	default "m1"

endif
```

## configs/apple_m1_defconfig
```kconfig
CONFIG_ARM=y
CONFIG_ARCH_APPLE=y
# CONFIG_DISPLAY_CPUINFO is not set
# CONFIG_MMC is not set
# CONFIG_NET is not set
# CONFIG_SIMPLE_PANEL is not set
CONFIG_S5P_SERIAL=y
CONFIG_VIDEO_SIMPLE=y
# CONFIG_REQUIRE_SERIAL_CONSOLE is not set
CONFIG_DISPLAY_BOARDINFO_LATE=y
CONFIG_NVME_APPLE=y
CONFIG_USB_XHCI_HCD=y
CONFIG_USB_XHCI_PCI=y
CONFIG_USB_XHCI_DWC3=y
CONFIG_USB_KEYBOARD=y
CONFIG_USB_STORAGE=y
CONFIG_USE_PREBOOT=y
CONFIG_PREBOOT="i2c dev 0; pci enum; nvme scan; usb start"
CONFIG_EFI_LOADER_BOUNCE_BUFFER=y
CONFIG_DEFAULT_DEVICE_TREE="t8103-j274"
CONFIG_BOOTDELAY=5
CONFIG_BOOTCOMMAND="nvme info; load nvme 0:4 0x900000000 stage2.image; load nvme 0:4 0x8f0000000 pearl.dtb; load nvme 0:4 0x820000000 pearl.cpio.gz; setenv fdt_high 0xFFFFFFFFFFFFFFFF; booti 0x900000000 - 0x8f0000000"
CONFIG_FS_BTRFS=y
CONFIG_CMD_MEM_SEARCH=y
CONFIG_CMD_STRINGS=y
```
